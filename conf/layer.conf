## conf/layer.conf
```bitbake
# We have a conf and classes directory, add to BBPATH
BBPATH .= ":${LAYERDIR}"

# We have recipes-* directories, add to BBFILES
BBFILES += "${LAYERDIR}/recipes-*/*/*.bb \
            ${LAYERDIR}/recipes-*/*/*.bbappend"

BBFILE_COLLECTIONS += "meta-vetassistant"
BBFILE_PATTERN_meta-vetassistant = "^${LAYERDIR}/"
BBFILE_PRIORITY_meta-vetassistant = "6"

LAYERDEPENDS_meta-vetassistant = "core"
LAYERSERIES_COMPAT_meta-vetassistant = "scarthgap"
```
